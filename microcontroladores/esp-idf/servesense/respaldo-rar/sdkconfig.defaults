## microcontroladores/esp-idf/servesense/respaldo-rar/sdkconfig.defaults
```kconfig
CONFIG_IDF_TARGET="esp32"
CONFIG_ESP_DEFAULT_CPU_FREQ_MHZ_240=y
CONFIG_ESP_MAIN_TASK_STACK_SIZE=8192
CONFIG_LOG_DEFAULT_LEVEL_INFO=y
CONFIG_NVS_ENABLED=y
CONFIG_ESP_CONSOLE_UART_DEFAULT=y
CONFIG_ESP_CONSOLE_UART_BAUDRATE=115200
CONFIG_FREERTOS_HZ=1000
```

## microcontroladores/esp-idf/servesense/sdkconfig.defaults
```kconfig
CONFIG_LOG_DEFAULT_LEVEL_INFO=y
CONFIG_LOG_DEFAULT_LEVEL=3
CONFIG_FREERTOS_HZ=1000
CONFIG_PARTITION_TABLE_SINGLE_APP=y
CONFIG_ESP_MAIN_TASK_STACK_SIZE=8192
```
